#include "dodo.dtsi" // Notice that the main dtsi files are included in the overlay.

&kscan_matrix {
    row-gpios
        = <&expander 12 (GPIO_ACTIVE_LOW | GPIO_PULL_UP)>
        , <&expander 11 (GPIO_ACTIVE_LOW | GPIO_PULL_UP)>
        , <&expander 10 (GPIO_ACTIVE_LOW | GPIO_PULL_UP)>
        , <&expander 9 (GPIO_ACTIVE_LOW | GPIO_PULL_UP)>
        , <&expander 8 (GPIO_ACTIVE_LOW | GPIO_PULL_UP)>
        ;
};

&right_encoder {
    status = "okay";
};

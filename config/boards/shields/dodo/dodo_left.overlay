#include "dodo.dtsi" // Notice that the main dtsi files are included in the overlay.

&kscan0 {
    col-gpios
        = <&expander 5 GPIO_ACTIVE_HIGH>
        , <&expander 4 GPIO_ACTIVE_HIGH>
        , <&expander 3 GPIO_ACTIVE_HIGH>
        , <&expander 2 GPIO_ACTIVE_HIGH>
        , <&expander 1 GPIO_ACTIVE_HIGH>
        , <&expander 0 GPIO_ACTIVE_HIGH>
        ;
};

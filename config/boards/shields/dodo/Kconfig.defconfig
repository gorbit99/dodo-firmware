## config/boards/shields/dodo/Kconfig.defconfig
```kconfig
if SHIELD_DODO_LEFT

  config ZMK_KEYBOARD_NAME
    default "Dodo"

  config ZMK_SPLIT_ROLE_CENTRAL
    default y

endif

if SHIELD_DODO_LEFT || SHIELD_DODO_RIGHT

  config ZMK_SPLIT
    default y

  config SPI
    default y

  config GPIO_HOGS
    default y

  config GPIO_HOGS_INIT_PRIORITY
    default 99
    
  config ZMK_DISPLAY
    default y
endif
```

## config/boards/shields/dodo/Kconfig.shield
```kconfig
config SHIELD_DODO_LEFT
  def_bool $(shields_list_contains,dodo_left)

config SHIELD_DODO_RIGHT
  def_bool $(shields_list_contains,dodo_right)
```
